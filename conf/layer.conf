## conf/layer.conf
```bitbake
# We have a conf and classes directory, add to BBPATH
BBPATH .= ":${LAYERDIR}"

# We have recipes-* directories, add to BBFILES
BBFILES += "${LAYERDIR}/recipes-*/*/*.bb \
            ${LAYERDIR}/recipes-*/*/*.bbappend \
            ${LAYERDIR}/recipes-*/*/*/*.bbappend"

BBFILES_DYNAMIC += "\
    meta-linux-mainline:${LAYERDIR}/meta-linux-mainline/recipes-*/*/*.bbappend \
"

BBFILE_COLLECTIONS += "meta-panfrost"
BBFILE_PATTERN_meta-panfrost = "^${LAYERDIR}/"
BBFILE_PRIORITY_meta-panfrost = "7"

LAYERDEPENDS_meta-panfrost = "core"
LAYERSERIES_COMPAT_meta-panfrost = "kirkstone scarthgap"
```
